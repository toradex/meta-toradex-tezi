## conf/machine/apalis-t30-mainline.conf
```bitbake
#@TYPE: Machine
#@NAME: Toradex Apalis T30 Mainline
#@SOC: Tegra T30
#@DESCRIPTION: Mainline Machine configuration for Toradex Apalis T30 SOM
#@MAINTAINER: Marcel Ziswiler <marcel.ziswiler@toradex.com>

require conf/machine/include/soc-family.inc

SOC_FAMILY = "tegram:tegra3m"

PREFERRED_PROVIDER_virtual/kernel = "linux-toradex-mainline"

KERNEL_IMAGETYPE = "uImage"
KERNEL_DEFCONFIG = "tegra_defconfig"
KERNEL_DEVICETREE += "tegra30-apalis-eval.dtb"

PREFERRED_PROVIDER_u-boot = "u-boot-toradex"
PREFERRED_PROVIDER_virtual/bootloader = "u-boot-toradex"
UBOOT_MACHINE = "apalis_t30_defconfig"
UBOOT_ENTRYPOINT = "0x82008000"
UBOOT_LOADADDRESS = "${UBOOT_ENTRYPOINT}"
# The payload offsets are given in number of 512 byte blocks.
OFFSET_BOOTROM_PAYLOAD = "0"

TEZI_UBOOT_BINARY_EMMC = "apalis_t30.img"

# require u-boot-dtb-tegra.bin to be used
UBOOT_IMAGE = "u-boot-dtb-tegra-${MACHINE}-${PV}-${PR}.${UBOOT_SUFFIX}"
UBOOT_BINARY = "u-boot-dtb-tegra.${UBOOT_SUFFIX}"
UBOOT_SYMLINK = "u-boot-dtb-tegra-${MACHINE}.${UBOOT_SUFFIX}"

PREFERRED_PROVIDER_lxde-icon-theme_apalis-t30-mainline = "lxde-icon-theme"
PREFERRED_PROVIDER_lxsession-lite_apalis-t30-mainline = "lxsession"
PREFERRED_PROVIDER_virtual/psplash = "psplash-angstrom"
PREFERRED_PROVIDER_psplash-support = "psplash-angstrom"

PREFERRED_PROVIDER_virtual/xserver ?= "xserver-xorg"
PREFERRED_VERSION_xserver-xorg_tegram = "99:1.19%"
PREFERRED_PROVIDER_virtual/mesa ?= "mesa"
PREFERRED_PROVIDER_virtual/libgl ?= "mesa"

#TBD
#swrast,tegra
GALLIUMDRIVERS_append_armv7a =",tegra"
XSERVER ?= "xserver-xorg \
            mesa-driver-swrast \
            mesa-driver-tegra \
            xf86-input-evdev \
            xf86-input-keyboard \
            xf86-input-mouse \
            xf86-video-modesetting \
            xf86-video-opentegra \
           "

MACHINE_FEATURES += "screen usbgadget usbhost vfat ext2 alsa touchscreen wifi bluetooth 3g pci "
EXTRA_IMAGEDEPENDS += "u-boot"

# used by sysvinit_2
SERIAL_CONSOLE = "115200 ttyS0"
IMAGE_CLASSES += "image_type_tezi"
IMAGE_FSTYPES = "tar.xz teziimg"

TORADEX_PRODUCT_IDS = "0025 0026 0031"
TORADEX_FLASH_TYPE = "emmc"

DEFAULTTUNE = "armv7athf-neon"
require conf/machine/include/tune-cortexa9.inc
```

## conf/machine/apalis-tk1-mainline.conf
```bitbake
#@TYPE: Machine
#@NAME: Toradex Apalis TK1 Mainline
#@SOC: Tegra K1
#@DESCRIPTION: Mainline Machine configuration for Toradex Apalis TK1 SOM
#@MAINTAINER: Dominik Sliwa <dominik.sliwa@toradex.com>

MACHINE_NAME = "Apalis-TK1-Mainline"

require conf/machine/include/soc-family.inc

SOC_FAMILY = "tegra124m"

PREFERRED_PROVIDER_virtual/kernel = "linux-toradex-mainline"
PREFERRED_VERSION_linux-toradex-mainline = "5.4%"

KERNEL_IMAGETYPE = "zImage"
KERNEL_DEFCONFIG = "tegra_defconfig"
KERNEL_DEVICETREE += "tegra124-apalis-eval.dtb tegra124-apalis-v1.2-eval.dtb"

MACHINE_BOOT_FILES = "boot.scr"

# wic support
IMAGE_BOOT_FILES ?= " \
    ${KERNEL_IMAGETYPE} \
    ${KERNEL_DEVICETREE} \
    ${MACHINE_BOOT_FILES} \
"

WKS_FILE_DEPENDS ?= " \
    virtual/bootloader \
    u-boot-distro-boot \
    \
    e2fsprogs-native \
    bmap-tools-native \
"

WKS_FILE = "sdimage-bootpart-tegra.wks"
WIC_CREATE_EXTRA_ARGS_append = " --no-fstab-update"

# The kernel lives in a seperate FAT or UBI partition, don't deploy it in /boot
RDEPENDS_${KERNEL_PACKAGE_NAME}-base = ""

PREFERRED_PROVIDER_u-boot = "u-boot-toradex"
PREFERRED_PROVIDER_virtual/bootloader = "u-boot-toradex-tk1"
PREFERRED_PROVIDER_u-boot-fw-utils ?= "u-boot-toradex-fw-utils-tk1"
UBOOT_MACHINE = "apalis-tk1_defconfig"
UBOOT_ENTRYPOINT = "0"
UBOOT_LOADADDRESS = "0x80008000"
UBOOT_KERNEL_TYPE = "kernel_noload"

# The payload offsets are given in number of 512 byte blocks.
OFFSET_BOOTROM_PAYLOAD = "0"

TEZI_DISTRO_BOOT_SCRIPTS = "boot.scr"
TEZI_UBOOT_BINARY_EMMC = "apalis-tk1.img"

# require u-boot-dtb-tegra.bin to be used
UBOOT_IMAGE = "u-boot-dtb-tegra-${MACHINE}-${PV}-${PR}.${UBOOT_SUFFIX}"
UBOOT_BINARY = "u-boot-dtb-tegra.${UBOOT_SUFFIX}"
UBOOT_SYMLINK = "u-boot-dtb-tegra-${MACHINE}.${UBOOT_SUFFIX}"

PREFERRED_PROVIDER_lxde-icon-theme_apalis-tk1-mainline = "lxde-icon-theme"
PREFERRED_PROVIDER_lxsession-lite_apalis-tk1-mainline = "lxsession"

PREFERRED_PROVIDER_virtual/xserver ?= "xserver-xorg"
PREFERRED_VERSION_xserver-xorg_tegra124m = "99:1.20%"
PREFERRED_PROVIDER_virtual/mesa ?= "mesa"
PREFERRED_PROVIDER_virtual/libgl ?= "mesa"

GALLIUMDRIVERS_append_armv7a =",nouveau"
XSERVER ?= "xserver-xorg \
            mesa-driver-nouveau \
            xf86-input-evdev \
            xf86-input-keyboard \
            xf86-input-mouse \
            xf86-video-modesetting \
           "

MACHINE_FEATURES = "screen usbgadget usbhost vfat ext2 alsa touchscreen wifi bluetooth 3g pci "
MACHINE_EXTRA_RDEPENDS = "linux-firmware-nvidia tdx-k20-fw"
EXTRA_IMAGEDEPENDS += "virtual/bootloader"

# used by sysvinit_2
SERIAL_CONSOLES = "115200;ttyS0"
IMAGE_CLASSES += "image_type_tezi"
IMAGE_FSTYPES += "wic.bmap wic.gz teziimg"

TORADEX_PRODUCT_IDS = "0034"
TORADEX_FLASH_TYPE = "emmc"

DEFAULTTUNE = "cortexa15hf-neon"
require conf/machine/include/tune-cortexa15.inc
```

## conf/machine/colibri-imx6.conf
```bitbake
#@TYPE: Machine
#@NAME: Toradex Colibri iMX6DL/S
#@SOC: i.MX6 DL/S
#@DESCRIPTION: Machine configuration for Toradex Colibri iMX6 SOM

DEFAULTTUNE_mx6 = "armv7athf-neon"
include conf/machine/include/imx-base.inc
include conf/machine/include/tune-cortexa9.inc

SOC_FAMILY = "mx6:mx6dl"

PREFERRED_PROVIDER_u-boot = "u-boot-toradex-fsl"
PREFERRED_PROVIDER_virtual/bootloader = "u-boot-toradex-fsl"
PREFERRED_PROVIDER_virtual/kernel = "linux-toradex-fsl"
KERNEL_DEVICETREE = "imx6dl-colibri-eval-v3.dtb imx6dl-colibri-cam-eval-v3.dtb"
KERNEL_IMAGETYPE = "uImage"

PREFERRED_VERSION_xserver-xorg_mx6 = "99:1.14%"

# don't pull in systemd 216 backported into meta-angstrom
PREFERRED_VERSION_systemd = "211%"

UBOOT_MACHINE = "colibri_imx6_defconfig"

SERIAL_CONSOLE = "115200 ttymxc0"

MACHINE_FEATURES += "screen usbgadget usbhost vfat ext2 alsa touchscreen wifi bluetooth 3g"
EXTRA_IMAGEDEPENDS += "u-boot"
```

## conf/machine/colibri-imx6ull.conf
```bitbake
#@TYPE: Machine
#@NAME: Toradex Colibri iMX6ULL for use with Toradex Easy Installer
#@SOC: i.MX6ULL
#@DESCRIPTION: Machine configuration for Toradex Colibri iMX6 ULL SOM for use with Toradex Easy Installer
#@MAINTAINER: Max Krummenacher <max.krummenacher@toradex.com>

MACHINEOVERRIDES =. "mx6:mx6ul:mx6ull:"

include conf/machine/include/imx-base.inc
include conf/machine/include/tune-cortexa7.inc

PREFERRED_PROVIDER_virtual/kernel_use-nxp-bsp ?= "linux-toradex"
KERNEL_DEVICETREE_forcevariable = "imx6ull-colibri-eval-v3.dtb imx6ull-colibri-emmc-eval-v3.dtb"
KERNEL_IMAGETYPE = "zImage"
# Do not install the kernel into the rootfs
RDEPENDS_${KERNEL_PACKAGE_NAME}-base = ""

PREFERRED_PROVIDER_u-boot ?= "u-boot-toradex"
PREFERRED_PROVIDER_virtual/bootloader ?= "u-boot-toradex"

UBOOT_MAKE_TARGET="u-boot-nand.imx"
UBOOT_CONFIG = "emmc rawnand recovery"
UBOOT_CONFIG[emmc] = "colibri-imx6ull-emmc_tezi_defconfig,,u-boot.imx"
UBOOT_CONFIG[rawnand] = "colibri-imx6ull_tezi_defconfig,,u-boot-nand.imx"
UBOOT_CONFIG[recovery] = "colibri-imx6ull_tezi-recovery_defconfig,,u-boot.imx"

UBOOT_ENTRYPOINT_colibri-imx6ull = "0x81000000"

# The payload offsets are given in number of 512 byte blocks.
OFFSET_BOOTROM_PAYLOAD = "2"

IMAGE_CLASSES += "image_type_tezi"
IMAGE_FSTYPES = "teziimg"

TORADEX_FLASH_TYPE = "emmc rawnand"
TORADEX_PRODUCT_IDS += "0062"
TORADEX_PRODUCT_IDS[0062] = "imx6ull-colibri-emmc-eval-v3.dtb,emmc"

TEZI_UBOOT_BINARY_EMMC = "u-boot.imx-emmc"
TEZI_UBOOT_BINARY_RAWNAND = "u-boot.imx-rawnand"

MACHINE_FEATURES += "screen usbgadget usbhost vfat ext2 alsa touchscreen wifi bluetooth 3g"
MACHINE_FIRMWARE_remove = "firmware-imx-epdc"
```

## conf/machine/colibri-imx7.conf
```bitbake
#@TYPE: Machine
#@NAME: Toradex Colibri iMX7 Solo 256MB/Dual 512MB/Dual 1GB
#@SOC: i.MX 7Dual / i.MX 7Solo
#@DESCRIPTION: Machine configuration for Toradex Colibri iMX7 SOM
#@MAINTAINER: Max Krummenacher <max.krummenacher@toradex.com>

MACHINEOVERRIDES =. "mx7:mx7d:"

include conf/machine/include/imx-base.inc
include conf/machine/include/tune-cortexa7.inc

PREFERRED_PROVIDER_virtual/kernel ?= "linux-toradex"
KERNEL_IMAGETYPE = "zImage"
KERNEL_DEVICETREE:forcevariable = "imx7d-colibri-eval-v3.dtb imx7s-colibri-eval-v3.dtb imx7d-colibri-emmc-eval-v3.dtb"

PREFERRED_PROVIDER_u-boot ?= "u-boot-toradex"
PREFERRED_PROVIDER_virtual/bootloader ?= "u-boot-toradex"

UBOOT_MAKE_TARGET="u-boot-nand.imx"
UBOOT_CONFIG = "rawnand emmc recovery"
UBOOT_CONFIG[recovery] = "colibri_imx7_tezi_recovery_defconfig,,u-boot.imx"
UBOOT_CONFIG[rawnand] = "colibri_imx7_tezi_defconfig,,u-boot-nand.imx"
UBOOT_CONFIG[emmc] = "colibri_imx7_emmc_tezi_defconfig,,u-boot.imx"

UBOOT_ENTRYPOINT:colibri-imx7 = "0x81000000"

# The payload offsets are given in number of 512 byte blocks.
OFFSET_BOOTROM_PAYLOAD = "2"

IMAGE_CLASSES += "image_type_tezi"
IMAGE_FSTYPES = "teziimg"

SERIAL_CONSOLE = "115200 ttymxc0"

TORADEX_FLASH_TYPE = "rawnand emmc"
TORADEX_PRODUCT_IDS = "0032 0033 0039 0041"
TORADEX_PRODUCT_IDS[0032] = "imx7s-colibri-eval-v3.dtb,rawnand"
TORADEX_PRODUCT_IDS[0033] = "imx7d-colibri-eval-v3.dtb,rawnand"
TORADEX_PRODUCT_IDS[0039] = "imx7d-colibri-emmc-eval-v3.dtb,emmc"
TORADEX_PRODUCT_IDS[0041] = "imx7d-colibri-eval-v3.dtb,rawnand"

TEZI_UBOOT_BINARY_EMMC = "u-boot.imx-emmc"
TEZI_UBOOT_BINARY_RAWNAND = "u-boot.imx-rawnand"

MACHINE_FEATURES += "screen usbgadget usbhost vfat ext2 alsa touchscreen wifi bluetooth 3g"
```

## conf/machine/colibri-pxa.conf
```bitbake
#@TYPE: Machine
#@NAME: colibri_pxa
#@DESCRIPTION: Toradex Colibri PXAxxx

TARGET_ARCH = "arm"

PREFERRED_PROVIDER_virtual/kernel = "linux-toradex"
KERNEL_IMAGETYPE = "uImage"

UBOOT_MACHINE = "colibri_pxa270_config"
UBOOT_ENTRYPOINT = "a0008000"
#KEEPUIMAGE = ""

PREFERRED_PROVIDER_virtual/xserver = "xserver-xorg"
XSERVER = "xserver-xorg \
           xf86-input-evdev \
           xf86-input-mouse \
           xf86-video-fbdev \
           xf86-input-keyboard"

MACHINE_GUI_CLASS = "smallscreen"

PREFERRED_PROVIDER_lxde-icon-theme_colibri-pxa = "lxde-icon-theme"
PREFERRED_PROVIDER_lxsession-lite_colibri-pxa = "lxsession"
PREFERRED_PROVIDER_virtual/psplash = "psplash-angstrom"
PREFERRED_PROVIDER_psplash-support = "psplash-angstrom"

MACHINE_FEATURES = "kernel26 screen usbgadget usbhost vfat ext2 alsa touchscreen ethernet"
EXTRA_IMAGEDEPENDS += "u-boot"

# used by sysvinit_2
SERIAL_CONSOLE = "115200 ttyS0"
IMAGE_FSTYPES ?= "tar.bz2"

require conf/machine/include/tune-xscale.inc
```

## conf/machine/colibri-vf50.conf
```bitbake
#@TYPE: Machine
#@NAME: colibri_vf50 SOM powered by Freescale Vybrid family
#@SOC: vf50
#@DESCRIPTION: Toradex Colibri VF50

include conf/machine/include/imx-base.inc
include conf/machine/include/tune-cortexa5.inc

#TODO
SOC_FAMILY = "vf60"

PREFERRED_PROVIDER_virtual/kernel = "linux-toradex-vf"
PREFERRED_PROVIDER_u-boot = "u-boot-colibri-vf"
UBOOT_SUFFIX = "nand"
UBOOT_MAKE_TARGET = ""
UBOOT_MACHINE = "colibri_vf50_config"

SDCARD_ROOTFS ?= "${DEPLOY_DIR_IMAGE}/${IMAGE_NAME}.rootfs.ext3"
IMAGE_FSTYPES ?= "tar.bz2 ext3 sdcard"

SERIAL_CONSOLE = "115200 ttymxc0"

MACHINE_FEATURES = "apm usbgadget usbhost vfat ext2 alsa touchscreen ethernet wifi bluetooth 3g"
EXTRA_IMAGEDEPENDS += "u-boot"
```

## recipes-bsp/tezi-run-metadata/files/apalis-imx6/tezi.its
```
/*
 * U-boot FIT image for Toradex Easy Installer
 */

/dts-v1/;

/ {
	description = "Toradex Easy Installer for Apalis iMX6";
	#address-cells = <1>;

	images {
		kernel@1 {
			description = "Linux Kernel @@KERNEL_VERSION@@";
			data = /incbin/("./zImage");
			type = "kernel";
			arch = "arm";
			os = "linux";
			compression = "none";
			load = <0x11000000>;
			entry = <0x11000000>;
			hash@1 {
				algo = "md5";
			};
		};

		ramdisk@1 {
			description = "SquashFS RAMdisk";
			data = /incbin/("./tezi-run-apalis-imx6.@@TEZI_INITRD_IMAGE@@");
			type = "ramdisk";
			arch = "arm";
			os = "linux";
			compression = "none";
			hash@1 {
				algo = "md5";
			};
		};

		fdt@1 {
			description = "Apalis iMX6 Device Tree";
			data = /incbin/("./imx6q-apalis-eval.dtb");
			type = "flat_dt";
			arch = "arm";
			compression = "none";
			hash@1 {
				algo = "md5";
			};
		};


	};

	configurations {
		default = "config@1";

		config@1 {
			description = "Toradex Easy Installer for Apalis iMX6";
			kernel = "kernel@1";
			ramdisk = "ramdisk@1";
			fdt = "fdt@1";
		};
	};
};
```

## recipes-bsp/tezi-run-metadata/files/apalis-imx8/tezi.its
```
/*
 * U-boot FIT image for Toradex Easy Installer
 */

/dts-v1/;

/ {
	description = "Toradex Easy Installer for Apalis iMX8";
	#address-cells = <1>;

	images {
		kernel@1 {
			description = "Linux Kernel 4.14";
			data = /incbin/("./Image.gz");
			type = "kernel";
			arch = "arm64";
			os = "linux";
			compression = "gzip";
			load = <0x80280000>;
			entry = <0x80280000>;
			hash@1 {
				algo = "md5";
			};
		};

		ramdisk@1 {
			description = "SquashFS RAMdisk";
			data = /incbin/("./tezi-run-apalis-imx8.squashfs");
			type = "ramdisk";
			arch = "arm64";
			os = "linux";
			compression = "none";
			load = <0xA0000000>;
			hash@1 {
				algo = "md5";
			};
		};

		fdt@1 {
			description = "Apalis iMX8 Device Tree";
			data = /incbin/("./fsl-imx8qm-apalis.dtb");
			type = "flat_dt";
			arch = "arm64";
			compression = "none";
			hash@1 {
				algo = "md5";
			};
		};


	};

	configurations {
		default = "config@1";

		config@1 {
			description = "Toradex Easy Installer for Apalis iMX8";
			kernel = "kernel@1";
			ramdisk = "ramdisk@1";
			fdt = "fdt@1";
		};
	};
};
```

## recipes-bsp/tezi-run-metadata/files/apalis-t30-mainline/tezi.its
```
/*
 * U-boot FIT image for Toradex Easy Installer
 */

/dts-v1/;

/ {
	description = "Toradex Easy Installer for Apalis T30";
	#address-cells = <1>;

	images {
		ramdisk@1 {
			description = "SquashFS RAMdisk";
			data = /incbin/("./tezi-run-apalis-t30-mainline.squashfs");
			type = "ramdisk";
			arch = "arm";
			os = "linux";
			compression = "none";
			hash@1 {
				algo = "md5";
			};
		};

		fdt@1 {
			description = "Apalis T30 Device Tree";
			data = /incbin/("./tegra30-apalis-eval.dtb");
			type = "flat_dt";
			arch = "arm";
			compression = "none";
			hash@1 {
				algo = "md5";
			};
		};

		kernel@1 {
			description = "Linux Kernel 4.14";
			data = /incbin/("./zImage");
			type = "kernel_noload";
			arch = "arm";
			os = "linux";
			compression = "none";
			load = <0x80008000>;
			entry = <0>;
			hash@1 {
				algo = "md5";
			};
		};
	};

	configurations {
		default = "config@1";

		config@1 {
			description = "Toradex Easy Installer for Apalis T30";
			kernel = "kernel@1";
			ramdisk = "ramdisk@1";
			fdt = "fdt@1";
		};
	};
};
```
