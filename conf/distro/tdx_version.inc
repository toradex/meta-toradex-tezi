## conf/distro/tdx_version.inc
```bitbake
# These variables are used to set image, kernel and U-Boot versions

TDX_BUILDNBR ?= "0"
TDX_PURPOSE ?= "Testing"

def get_tdx_prerelease(purpose, datetime):
    if purpose == "Testing":
        return '-devel-%s' % (datetime)
    elif purpose == "Nightly":
        return '-devel-%s' % (datetime[:8])
    elif purpose == "Monthly":
        return '-devel-%s' % (datetime[:6])
    elif purpose == "Release":
        return ''
    else:
        return '-devel-%s' % (datetime)

TDX_BUILD ?= "+build.${TDX_BUILDNBR}"
TDX_MATRIX_BUILD_TIME ?= "${DATETIME}"
TDX_MATRIX_BUILD_TIME[vardepsexclude] = "DATETIME"
TDX_PRERELEASE ?= "${@get_tdx_prerelease(d.getVar('TDX_PURPOSE'), d.getVar('TDX_MATRIX_BUILD_TIME'))}"
TDX_MAJOR ?= "6"
TDX_MINOR ?= "6"
TDX_PATCH ?= "0"
TDX_RELEASE ?= "${TDX_MAJOR}.${TDX_MINOR}.${TDX_PATCH}"

# Toradex Version number without date for U-Boot/Kernel and other Toradex
# specific software artifacts.
TDX_VERSION ?= "${TDX_RELEASE}${@'' if d.getVar('TDX_PURPOSE') == 'Release' else '-devel'}"

# Complete image version with date and build number
DISTRO_VERSION = "${TDX_RELEASE}${TDX_PRERELEASE}${TDX_BUILD}"

TDX_VER_ID:apalis-imx6 = "Apalis-iMX6_ToradexEasyInstaller_${DISTRO_VERSION}"
TDX_VER_ID:apalis-imx8 = "Apalis-iMX8_ToradexEasyInstaller_${DISTRO_VERSION}"
TDX_VER_ID:colibri-imx6 = "Colibri-iMX6_ToradexEasyInstaller_${DISTRO_VERSION}"
TDX_VER_ID:colibri-imx6ull = "Colibri-iMX6ULL_ToradexEasyInstaller_${DISTRO_VERSION}"
TDX_VER_ID:colibri-imx7 = "Colibri-iMX7_ToradexEasyInstaller_${DISTRO_VERSION}"
TDX_VER_ID:colibri-imx8x = "Colibri-iMX8X_ToradexEasyInstaller_${DISTRO_VERSION}"
TDX_VER_ID:verdin-imx8mm = "Verdin-iMX8MM_ToradexEasyInstaller_${DISTRO_VERSION}"
TDX_VER_ID:verdin-imx8mp = "Verdin-iMX8MP_ToradexEasyInstaller_${DISTRO_VERSION}"
TDX_VER_ID:verdin-am62 = "Verdin-AM62_ToradexEasyInstaller_${DISTRO_VERSION}"
```

## conf/distro/tezi.conf
```bitbake
DISTRO_NAME="Toradex Easy Installer"
DISTRO_VERSION="2.4"

DISTRO_FEATURES="acl ipv4 keyboard usbhost usbgadget ext2 largefile wayland xattr"
DISTRO_FEATURES_BACKFILL_CONSIDERED="pulseaudio bluez5"

DISTROOVERRIDES .= ":tdx-distro"

TCLIBC = "glibc"
IMAGE_LINGUAS = ""

INHERIT += "buildhistory"
BUILDHISTORY_COMMIT = "1"

INITRAMFS_IMAGE = "tezi-initramfs"
INITRAMFS_FSTYPES = "squashfs"
INITRAMFS_MAXSIZE = "160000"
FIT_SUPPORTED_INITRAMFS_FSTYPES = "${INITRAMFS_FSTYPES}"

VIRTUAL-RUNTIME_dev_manager = "udev"
VIRTUAL-RUNTIME_login_manager = ""
VIRTUAL-RUNTIME_init_manager = "tezi-init"

MACHINE_EXTRA_RRECOMMENDS:remove = "udev-rules-imx linux-firmware-ath11k linux-firmware-qca"
MACHINE_EXTRA_RRECOMMENDS:remove = "linux-firmware-ath12k linux-firmware-nxpiw416-sdio linux-firmware-powervr"
MACHINE_EXTRA_RRECOMMENDS:append = " udev-rules-tezi"

# Avoid installing shared-mime-info recommended by the glib2 recipe (oe-core)
# It is not required for Tezi functionality and significantly increases the
# initramfs size.
BAD_RECOMMENDATIONS = "shared-mime-info"

# Avoid egl build dependency, which is not compatible with imx7 and we don't need it anyway
# Avoid imx variant drm dependency, we use regular drm
BBMASK += " \
    /meta-freescale/dynamic-layers/qt5-layer/recipes-qt/qt5/ \
    /meta-freescale/recipes-graphics/drm/ \
    /meta-freescale/recipes-graphics/wayland/weston-init.bbappend \
    /meta-toradex-nxp/recipes-graphics/drm \
    /meta-toradex-bsp-common/recipes-bsp/u-boot/u-boot-distro-boot.bb \
"

# AM62: don't use the GPU
PREFERRED_PROVIDER_virtual/gpudriver:k3 = ""

# Qt5 extra configuration
PACKAGECONFIG:append:pn-qtbase = " linuxfb no-opengl xkbcommon fontconfig"
PACKAGECONFIG:remove:pn-qtbase:k3 = " gbm gles2 gles2extra icu kms linuxfb"
PACKAGECONFIG:remove:pn-qtwayland = "wayland-egl wayland-server"

MACHINE_SOCARCH_FILTER:append:mx8-generic-bsp = " qtbase"

# Get rid of EGL and GLESv2 in cairo
PACKAGECONFIG:remove:pn-cairo = "egl glesv2"

IMX_DEFAULT_BSP = "mainline"
IMX_DEFAULT_BSP:apalis-imx8 = "nxp"
IMX_DEFAULT_BSP:colibri-imx8x = "nxp"
IMX_DEFAULT_BSP:verdin-imx8mp = "nxp"
IMX_DEFAULT_BSP:toradex-smarc-imx95 = "nxp"
IMX_DEFAULT_BSP:toradex-smarc-imx8mp = "nxp"

PREFERRED_PROVIDER_virtual/dtb ?= "device-tree-overlays"

PREFERRED_PROVIDER_u-boot-default-script = "u-boot-distro-boot"
PREFERRED_VERSION_u-boot-distro-boot = "1.1"

PREFERRED_VERSION_weston:forcevariable = "9.0.0"
PREFERRED_VERSION_wayland:forcevariable = "1.22.0"
PREFERRED_VERSION_wayland-protocols:forcevariable = "1.33"
PREFERRED_VERSION_libdrm:forcevariable = "2.4.120"

# Remove python from tezi-devel (gets pulled by gdb bbappend in meta-qt5)
PACKAGECONFIG:remove:pn-gdb = "python"

# Make sure we use OpenSSL, remove libidn, verbose and *auth from what would
# otherwise be the default.
PACKAGECONFIG:pn-curl = "ipv6 openssl proxy threaded-resolver zlib"
PACKAGECONFIG:pn-wpa-supplicant = "openssl"

# Enable acl support in GNU tar
PACKAGECONFIG:pn-tar = "acl"

# Add License files to image
COPY_LIC_DIRS = "1"
COPY_LIC_MANIFEST = "1"

# Some Toradex recipes like linux-toradex, u-boot-toradex, device-tree-overlays,
# qt-tezi, qt-tezictl are appending SCM hashes to PV, version
# numbers going backwards are not a problem as we don't provide
# binary feeds.
#
# This avoids some annoying errors as follows:
# | QA Issue: Package version went backwards which would break package feeds
ERROR_QA:remove = "version-going-backwards"

# Explicitly use fitimage
KERNEL_CLASSES:append = " kernel-fitimage"
KERNEL_IMAGETYPE:forcevariable = "fitImage"
KERNEL_ALT_IMAGETYPE = "zImage"
KERNEL_ALT_IMAGETYPE:mx8-generic-bsp = "Image"
KERNEL_ALT_IMAGETYPE:mx9-generic-bsp = "Image"
KERNEL_ALT_IMAGETYPE:k3 = "Image"

# Make sure kernel does not get deployed into rootfs
RRECOMMENDS:${KERNEL_PACKAGE_NAME}-base = ""

# No firmwares required for a simple Qt UI
MACHINE_FIRMWARE:remove = "firmware-imx-vpu-imx6q firmware-imx-vpu-imx6d firmware-imx-vpu-imx8 firmware-imx-epdc linux-firmware-ath10k"

MACHINE_EXTRA_RDEPENDS:append:colibri-imx6ull = " mtd-utils-ubifs mtd-utils kobs-ng"
MACHINE_EXTRA_RDEPENDS:append:colibri-imx7 = " mtd-utils-ubifs mtd-utils kobs-ng"

UBOOT_MAKE_TARGET:apalis-imx6 = "u-boot.img SPL"
UBOOT_MAKE_TARGET:colibri-imx6 = "u-boot.img SPL"
# work around colibri-imx7/colibri-imx6ull being overridden a second time
# later on in machine config
UBOOT_MAKE_TARGET:colibri-imx6ull:forcevariable = "u-boot-nand.imx"
UBOOT_MAKE_TARGET:colibri-imx7:forcevariable = "u-boot-nand.imx"

UBOOT_SUFFIX:apalis-imx6 = "img"
UBOOT_SUFFIX:colibri-imx6 = "img"
SPL_BINARY:apalis-imx6 = "SPL"
SPL_BINARY:colibri-imx6 = "SPL"

MACHINE_BOOT_FILES = "boot.scr overlays.txt"
MACHINE_BOOT_FILES:append:apalis-imx8 = " hdmitxfw.bin"

UBOOT_CONFIG:apalis-imx8 = "recoverytezi sd"
UBOOT_CONFIG_BASENAME:apalis-imx8 = "apalis-imx8"

UBOOT_CONFIG:colibri-imx8x = "recoverytezi sd"
UBOOT_CONFIG_BASENAME:colibri-imx8x = "colibri-imx8x"

UBOOT_CONFIG:apalis-imx6 = "recoverytezi sd"
UBOOT_CONFIG_BASENAME:apalis-imx6 = "apalis_imx6"

UBOOT_CONFIG:colibri-imx6 = "recoverytezi sd"
UBOOT_CONFIG_BASENAME:colibri-imx6 = "colibri_imx6"

# The payload offsets are given in number of 512 byte blocks.
OFFSET_BOOTROM_PAYLOAD:colibri-imx6ull = "2"
TORADEX_FLASH_TYPE:colibri-imx6ull = "rawnand emmc"
KERNEL_DEVICETREE:colibri-imx6ull = "\
    ${KERNEL_DTB_PREFIX}imx6ull-colibri-eval-v3.dtb \
    ${KERNEL_DTB_PREFIX}imx6ull-colibri-emmc-eval-v3.dtb \
    ${KERNEL_DTB_PREFIX}imx6ull-colibri-wifi-eval-v3.dtb \
"

UBOOT_BINARY:colibri-imx6ull = "u-boot.imx"
UBOOT_CONFIG:colibri-imx6ull = "rawnand emmc recoverytezi"
UBOOT_CONFIG_BASENAME:colibri-imx6ull = "colibri-imx6ull"
UBOOT_MACHINE:colibri-imx6ull = ""

# The payload offsets are given in number of 512 byte blocks.
OFFSET_BOOTROM_PAYLOAD:colibri-imx7 = "2"
TORADEX_FLASH_TYPE:colibri-imx7 = "rawnand emmc"
KERNEL_DEVICETREE:colibri-imx7 = "\
    ${KERNEL_DTB_PREFIX}imx7d-colibri-emmc-eval-v3.dtb \
    ${KERNEL_DTB_PREFIX}imx7d-colibri-eval-v3.dtb \
    ${KERNEL_DTB_PREFIX}imx7s-colibri-eval-v3.dtb \
"

UBOOT_BINARY:colibri-imx7 = "u-boot.imx"
UBOOT_CONFIG:colibri-imx7 = "rawnand emmc recoverytezi"
UBOOT_CONFIG_BASENAME:colibri-imx7 = "colibri_imx7"
UBOOT_MACHINE:colibri-imx7 = ""

# As TEZI uses the same build for both eMMC and NAND devices, we need to
# append the eMMC TORADEX_PRODUCT_IDS as the "colibri-imx7/6ull" will only use
# the NAND IDS by default
TORADEX_PRODUCT_IDS:colibri-imx6ull = "0036 0040 0044 0045 0062"
TORADEX_PRODUCT_IDS:colibri-imx7 = "0032 0033 0039 0041 0081"
TORADEX_PRODUCT_IDS[0032] = "imx7s-colibri-eval-v3.dtb,rawnand"
TORADEX_PRODUCT_IDS[0033] = "imx7d-colibri-eval-v3.dtb,rawnand"
TORADEX_PRODUCT_IDS[0036] = "imx6ull-colibri-eval-v3.dtb,rawnand"
TORADEX_PRODUCT_IDS[0039] = "imx7d-colibri-emmc-eval-v3.dtb,emmc"
TORADEX_PRODUCT_IDS[0040] = "imx6ull-colibri-wifi-eval-v3.dtb,rawnand"
TORADEX_PRODUCT_IDS[0041] = "imx7d-colibri-eval-v3.dtb,rawnand"
TORADEX_PRODUCT_IDS[0044] = "imx6ull-colibri-eval-v3.dtb,rawnand"
TORADEX_PRODUCT_IDS[0045] = "imx6ull-colibri-wifi-eval-v3.dtb,rawnand"
TORADEX_PRODUCT_IDS[0062] = "imx6ull-colibri-emmc-eval-v3.dtb,emmc"
TORADEX_PRODUCT_IDS[0081] = "imx7d-colibri-eval-v3.dtb,rawnand"

UBOOT_CONFIG:verdin-am62 = "recoverytezi sd"
UBOOT_CONFIG_BASENAME:verdin-am62 = "verdin-am62_a53"
# Not needed for the k3r5 case, modify the a53 config to make the generic code
# not fail.
UBOOT_CONFIG_BASENAME:verdin-am62-k3r5 = "verdin-am62_a53"

UBOOT_CONFIG:aquila-am69 = "recoverytezi sd"
UBOOT_CONFIG_BASENAME:aquila-am69 = "aquila-am69_a72"
# Not needed for the k3r5 case, modify the a53 config to make the generic code
# not fail.
UBOOT_CONFIG_BASENAME:aquila-am69-k3r5 = "aquila-am69_a72"

UBOOT_CONFIG:verdin-imx8mm = "recoverytezi sd"
UBOOT_CONFIG_BASENAME:verdin-imx8mm = "verdin-imx8mm"

UBOOT_CONFIG:verdin-imx8mp = "recoverytezi sd"
UBOOT_CONFIG_BASENAME:verdin-imx8mp = "verdin-imx8mp"

UBOOT_CONFIG:toradex-smarc-imx8mp = "recoverytezi sd"
UBOOT_CONFIG_BASENAME:toradex-smarc-imx8mp = "toradex-smarc-imx8mp"

UBOOT_CONFIG:toradex-smarc-imx95 = "recoverytezi sd"
UBOOT_CONFIG_BASENAME:toradex-smarc-imx95 = "toradex-smarc-imx95"

UBOOT_CONFIG[recoverytezi] = "${UBOOT_CONFIG_BASENAME}_tezi_defconfig"
UBOOT_CONFIG[sd] = "${UBOOT_CONFIG_BASENAME}_defconfig"
UBOOT_CONFIG[rawnand] = "${UBOOT_CONFIG_BASENAME}_defconfig,,u-boot-nand.imx"
UBOOT_CONFIG[emmc] = "${@'colibri_imx7_emmc_defconfig' if d.getVar('MACHINE') == 'colibri-imx7' else 'colibri-imx6ull-emmc_defconfig'}"

TEZI_EXTERNAL_KERNEL_DEVICETREE_BOOT:apalis-imx6 = "apalis-imx6_vga-640x480_overlay.dtbo apalis-imx6_hdmi_overlay.dtbo"
TEZI_EXTERNAL_KERNEL_DEVICETREE_BOOT:colibri-imx6 = "colibri-imx6_vga-640x480_overlay.dtbo colibri-imx6_hdmi_overlay.dtbo"
TEZI_EXTERNAL_KERNEL_DEVICETREE_BOOT:colibri-imx6ull = "colibri-imx6ull_vga-640x480_overlay.dtbo"
TEZI_EXTERNAL_KERNEL_DEVICETREE_BOOT:colibri-imx7 = "colibri-imx7_vga-640x480_overlay.dtbo"

UBOOT_ENTRYPOINT:apalis-imx6 = "0x11000000"
UBOOT_ENTRYPOINT:colibri-imx6 = "0x11000000"

UBOOT_DTB_LOADADDRESS:mx8-generic-bsp     = "0x87000000"
UBOOT_DTBO_LOADADDRESS:mx8-generic-bsp    = "0x870F0000"
UBOOT_DTB_LOADADDRESS_verdin  = "0x4A000000"
UBOOT_DTBO_LOADADDRESS_verdin = "0x4A0F0000"
UBOOT_DTB_LOADADDRESS:colibri-imx6 = "0x14200000"
UBOOT_DTBO_LOADADDRESS:colibri-imx6 = "0x142F0000"
UBOOT_DTB_LOADADDRESS:apalis-imx6 = "0x14200000"
UBOOT_DTBO_LOADADDRESS:apalis-imx6 = "0x142F0000"
UBOOT_DTB_LOADADDRESS:colibri-imx6ull = "0x90010000"
UBOOT_DTBO_LOADADDRESS:colibri-imx6ull = "0x90100000"
UBOOT_DTB_LOADADDRESS:colibri-imx7 = "0x90010000"
UBOOT_DTBO_LOADADDRESS:colibri-imx7 = "0x90100000"

# keep the dtb vendor directories in fitimage node names
KERNEL_DTBVENDORED = "1"

require conf/distro/tdx_version.inc
```

## conf/layer.conf
```bitbake
BBPATH .= ":${LAYERDIR}"
BBFILES += "${LAYERDIR}/recipes-*/*/*.bb \
    ${LAYERDIR}/recipes-*/*/*.bbappend"
BBFILE_COLLECTIONS += "toradex-tezi"
BBFILE_PATTERN_toradex-tezi = "^${LAYERDIR}/"
BBFILE_PRIORITY_toradex-tezi = "96"

LAYERDEPENDS_toradex-tezi = "toradex-nxp-layer toradex-tegra-layer qt5-layer"
LAYERSERIES_COMPAT_toradex-tezi = "dunfell"
```

## conf/machine/apalis-imx6.conf
```bitbake
#@TYPE: Machine
#@NAME: Toradex Apalis iMX6Q/D
#@SOC: i.MX6
#@DESCRIPTION: Machine configuration for Toradex Apalis iMX6 SOM

DEFAULTTUNE_mx6 = "armv7athf-neon"
include conf/machine/include/imx-base.inc
include conf/machine/include/tune-cortexa9.inc

SOC_FAMILY = "mx6:mx6q"

PREFERRED_PROVIDER_u-boot = "u-boot-toradex-fsl"
PREFERRED_PROVIDER_virtual/bootloader = "u-boot-toradex-fsl"
PREFERRED_PROVIDER_virtual/kernel = "linux-toradex-fsl"
KERNEL_DEVICETREE = "imx6q-apalis-eval.dtb imx6q-apalis-eval_v1_0.dtb"
KERNEL_IMAGETYPE = "uImage"

PREFERRED_VERSION_xserver-xorg_mx6 = "99:1.14%"

# don't pull in systemd 216 backported into meta-angstrom
PREFERRED_VERSION_systemd = "211%"

UBOOT_MACHINE = "apalis_imx6_defconfig"

SERIAL_CONSOLE = "115200 ttymxc0"

MACHINE_FEATURES += "screen usbgadget usbhost vfat ext2 alsa touchscreen wifi bluetooth 3g pci "
EXTRA_IMAGEDEPENDS += "u-boot"
```

## conf/machine/apalis-imx8x.conf
```bitbake
#@TYPE: Machine
#@NAME: Toradex Apalis iMX8X
#@DESCRIPTION: Toradex Apalis iMX8X powered by a i.MX 8X SoC
#@MAINTAINER: Philippe Schenker <philippe.schenker@toradex.com>

MACHINE_NAME = "Apalis-iMX8X"

# for C0 silicon add mx8qxpc0 to the right of mx8qxp
MACHINEOVERRIDES =. "mx8:mx8x:mx8qxp:"

require conf/machine/include/imx-base.inc
require conf/machine/include/arm/arch-arm64.inc

# Don't include kernels in standard images
RDEPENDS_${KERNEL_PACKAGE_NAME}-base = ""

LOADADDR = ""

# we do not want to have getty running on tty1 as we run
# auto-serial-console there
USE_VT = "0"

KERNEL_DEVICETREE = " \
    freescale/fsl-imx8qxp-apalis-eval.dtb \
"

UBOOT_SUFFIX = "bin"
UBOOT_CONFIG ??= "sd"
UBOOT_CONFIG[sd] = "apalis-imx8x_config,sdcard"

UBOOT_ENTRYPOINT = "0x80280000"
UBOOT_RD_LOADADDRESS = "0xA0000000"

BOOT_SPACE = "65536"
IMAGE_BOOTLOADER = "imx-boot"
IMX_BOOT_SEEK = "32"

MACHINE_BOOT_FILES = "boot.scr"
IMAGE_BOOT_FILES_append = " ${MACHINE_BOOT_FILES}"
WKS_FILE_DEPENDS_append = " u-boot-distro-boot"

PREFERRED_PROVIDER_virtual/kernel = "linux-toradex"
PREFERRED_PROVIDER_virtual/bootloader = "u-boot-toradex"
PREFERRED_PROVIDER_u-boot-fw-utils ?= "u-boot-toradex-fw-utils"
# Currently we use the nxp 2018.03 downstream for mx8 as some features are
# not yet available in 2019.03.
PREFERRED_VERSION_u-boot-toradex = "2018.03"
PREFERRED_VERSION_u-boot-toradex-fw-utils = "2018.03"

MACHINE_FIRMWARE_append = " linux-firmware-usb8997"
MACHINE_FIRMWARE_append = " firmware-imx-vpu-imx8"

IMXBOOT_TARGETS = "flash"

PREFERRED_PROVIDER_virtual/libg2d_imxdpu = "imx-dpu-g2d"

BOARD_TYPE = "apalis"

IMAGE_CLASSES_append = " image_type_tezi"
IMAGE_FSTYPES += "teziimg"

# The imx-boot container takes care for the i.MX 8 offset, so the container
# has to be flashed at offset 0 directly
UBOOT_BINARY_TEZI_EMMC="imx-boot"
OFFSET_BOOTROM_PAYLOAD="0"

TORADEX_PRODUCT_IDS = "0046 0053 0054 2600"
TORADEX_PRODUCT_IDS[0046] = "fsl-imx8qxp-apalis-eval.dtb"
TORADEX_PRODUCT_IDS[0053] = "fsl-imx8qxp-apalis-eval.dtb"
TORADEX_PRODUCT_IDS[0054] = "fsl-imx8qxp-apalis-eval.dtb"
TORADEX_PRODUCT_IDS[2600] = "fsl-imx8qxp-apalis-eval.dtb"
```
