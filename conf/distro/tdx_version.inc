## scripts/tezi.its
```
/*
 * U-boot FIT image for Toradex Installer
 */

/dts-v1/;

/ {
	description = "Toradex Installer for Apalis iMX6";
	#address-cells = <1>;

	images {
		kernel@1 {
			description = "Linux Kernel 3.14.52";
			data = /incbin/("./zImage");
			type = "kernel";
			arch = "arm";
			os = "linux";
			compression = "none";
			load = <0x11000000>;
			entry = <0x11000000>;
			hash@1 {
				algo = "md5";
			};
		};

		ramdisk@1 {
			description = "SquashFS RAMdisk";
			data = /incbin/("./tezi-run-apalis-imx6.squashfs");
			type = "ramdisk";
			arch = "arm";
			os = "linux";
			compression = "none";
			hash@1 {
				algo = "md5";
			};
		};

		fdt@1 {
			description = "Apalis iMX6 Device Tree";
			data = /incbin/("./zImage-imx6q-apalis-eval.dtb");
			type = "flat_dt";
			arch = "arm";
			compression = "none";
			hash@1 {
				algo = "md5";
			};
		};


	};

	configurations {
		default = "config@1";

		config@1 {
			description = "Toradex Installer for Apalis iMX6";
			kernel = "kernel@1";
			ramdisk = "ramdisk@1";
			fdt = "fdt@1";
		};
	};
};
```
